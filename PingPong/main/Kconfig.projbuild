## PingPong/main/Kconfig.projbuild
```kconfig
menu "Application Configuration"

	choice POLARITY
		prompt "Communication Polarity"
		default Primary
		help
			Select Communication Polarity.
		config PRIMARY
			bool "Primary"
			help
				As Echo Client.
		config SECONDARY
			bool "Secondary"
			help
				As Echo Server.
	endchoice

endmenu 
```

## basic/main/Kconfig.projbuild
```kconfig
menu "Application Configuration"

	choice DIRECTION
		prompt "Communication polarity"
		default RECEIVER
		help
			Select Communication direction.
		config RECEIVER
			bool "Receiver"
			help
				Execute Receiver.
		config TRANSMITTER
			bool "Transmitter"
			help
				Execute Transmitter.
	endchoice

endmenu 
```

## components/cc1100/Kconfig.projbuild
```kconfig
menu "CC1101 Example configuration"

	config GPIO_RANGE_MAX
		int
		default 33 if IDF_TARGET_ESP32
		default 46 if IDF_TARGET_ESP32S2
		default 19 if IDF_TARGET_ESP32C3
		default 48 if IDF_TARGET_ESP32S3

	config CSN_GPIO
		int "CC1101 CSN GPIO"
		range 0 GPIO_RANGE_MAX
		default 5  if IDF_TARGET_ESP32
		default 34 if IDF_TARGET_ESP32S2
		default 9  if IDF_TARGET_ESP32C3
		help
			Pin Number to be used as the CSN SPI signal.

	config MISO_GPIO
		int "CC1101 MISO GPIO"
		range 0 GPIO_RANGE_MAX
		default 19 if IDF_TARGET_ESP32
		default 33 if IDF_TARGET_ESP32S2
		default 18 if IDF_TARGET_ESP32C3
		help
			Pin Number to be used as the MISO SPI signal.

	config MOSI_GPIO
		int "CC1101 MOSI GPIO"
		range 0 GPIO_RANGE_MAX
		default 23 if IDF_TARGET_ESP32
		default 35 if IDF_TARGET_ESP32S2
		default 19 if IDF_TARGET_ESP32C3
		help
			Pin Number to be used as the MOSI SPI signal.

	config SCK_GPIO
		int "CC1101 SCK GPIO"
		range 0 GPIO_RANGE_MAX
		default 18 if IDF_TARGET_ESP32
		default 36 if IDF_TARGET_ESP32S2
		default 10 if IDF_TARGET_ESP32C3
		help
			Pin Number to be used as the SCK SPI signal.

	config GDO2_GPIO
		int "CC1101 GDO2 GPIO"
		range 0 GPIO_RANGE_MAX
		default 15 if IDF_TARGET_ESP32
		default 37 if IDF_TARGET_ESP32S2
		default 8  if IDF_TARGET_ESP32C3
		help
			Pin Number to be used as the GDO2 signal.

	config CC1101_ADDRESS
		int "CC1101 my address"
		range 1 254
		default 3
		help
			Both receiver and transmitter must have the same address

	config CC1101_CHANNEL
		int "CC1101 channel"
		range 1 254
		default 1
		help
			Both receiver and transmitter must operate on the same channel

	choice
		prompt "CC1101 Frequency"
		default CC1101_FREQ2
		help
				Select ISM band frequency

		config CC1101_FREQ1
				bool "315 MHz" 
		config CC1101_FREQ2
				bool "433 MHz" 
		config CC1101_FREQ3
				bool "868 MHz" 
		config CC1101_FREQ4
				bool "915 MHz" 
	endchoice

	config CC1101_FREQ
		int
		default 1 if CC1101_FREQ1
		default 2 if CC1101_FREQ2
		default 3 if CC1101_FREQ3
		default 4 if CC1101_FREQ4

	choice
		prompt "CC1101 Modulation mode"
		default CC1101_MODE2
		help
			Select Modulation mode

		config CC1101_MODE1
				bool "GFSK 1.2 kbit mode/speed" 
		config CC1101_MODE2
				bool "GFSK 38.4 kbit mode/speed" 
		config CC1101_MODE3
				bool "GFSK 100 kbit mode/speed" 
		config CC1101_MODE4
				bool "MSK 250 kbit mode/speed" 
		config CC1101_MODE5
				bool "MSK 500 kbit mode/speed" 
		config CC1101_MODE6
				bool "OOK 4.8 kbit mode/speed" 
	endchoice

	config CC1101_MODE
		int
		default 1 if CC1101_MODE1
		default 2 if CC1101_MODE2
		default 3 if CC1101_MODE3
		default 4 if CC1101_MODE4
		default 5 if CC1101_MODE5
		default 6 if CC1101_MODE6

	choice
		prompt "CC1101 TX Power level"
		config CC1101_POWER_130
			bool "-30 dB"
		config CC1101_POWER_120
			bool "-20 dB"
		config CC1101_POWER_115
			bool "-15 dB"
		config CC1101_POWER_110
			bool "-10 dB"
		config CC1101_POWER_0
			bool "0 dB"
		config CC1101_POWER_5
			bool "5 dB"
		config CC1101_POWER_7
			bool "7 dB"
		config CC1101_POWER_10
			bool "10 dB"
		help
			Select Tx Power level
	endchoice

	config CC1101_POWER_LEVEL
		int
		default -30 if CC1101_POWER_130
		default -20 if CC1101_POWER_120
		default -15 if CC1101_POWER_115
		default -10 if CC1101_POWER_110
		default 0 if CC1101_POWER_0
		default 5 if CC1101_POWER_5
		default 7 if CC1101_POWER_7
		default 10 if CC1101_POWER_10

endmenu
```

## components/cc1101/Kconfig.projbuild
```kconfig
menu "CC1101 Configuration"

	config GPIO_RANGE_MAX
		int
		default 33 if IDF_TARGET_ESP32
		default 46 if IDF_TARGET_ESP32S2
		default 48 if IDF_TARGET_ESP32S3
		default 18 if IDF_TARGET_ESP32C2
		default 19 if IDF_TARGET_ESP32C3
		default 30 if IDF_TARGET_ESP32C6

	config MISO_GPIO
		int "CC1101 MISO GPIO"
		range 0 GPIO_RANGE_MAX
		default 19 if IDF_TARGET_ESP32
		default 37 if IDF_TARGET_ESP32S2 || IDF_TARGET_ESP32S3
		default  4 # C3 and others
		help
			Pin Number to be used as the MISO SPI signal.

	config SCK_GPIO
		int "CC1101 SCK GPIO"
		range 0 GPIO_RANGE_MAX
		default 18 if IDF_TARGET_ESP32
		default 36 if IDF_TARGET_ESP32S2 || IDF_TARGET_ESP32S3
		default  3 # C3 and others
		help
			Pin Number to be used as the SCK SPI signal.

	config MOSI_GPIO
		int "CC1101 MOSI GPIO"
		range 0 GPIO_RANGE_MAX
		default 23 if IDF_TARGET_ESP32
		default 35 if IDF_TARGET_ESP32S2 || IDF_TARGET_ESP32S3
		default  2 # C3 and others
		help
			Pin Number to be used as the MOSI SPI signal.

	config CSN_GPIO
		int "CC1101 CSN GPIO"
		range 0 GPIO_RANGE_MAX
		default  5 if IDF_TARGET_ESP32
		default 34 if IDF_TARGET_ESP32S2 || IDF_TARGET_ESP32S3
		default  1 # C3 and others
		help
			Pin Number to be used as the CSN SPI signal.

	config GDO0_GPIO
		int "CC1101 GDO0 GPIO"
		range 0 GPIO_RANGE_MAX
		default 15 if IDF_TARGET_ESP32
		default 33 if IDF_TARGET_ESP32S2 || IDF_TARGET_ESP32S3
		default  0 # C3 and others
		help
			Pin Number to be used as the GDO0 signal.

	choice SPI_HOST
		prompt "SPI peripheral that controls this bus"
		default SPI2_HOST
		help
			Select SPI peripheral that controls this bus.
		config SPI2_HOST
			bool "SPI2_HOST"
			help
				Use SPI2_HOST. This is also called HSPI_HOST.
		config SPI3_HOST
			depends on IDF_TARGET_ESP32 || IDF_TARGET_ESP32S2 || IDF_TARGET_ESP32S3
			bool "SPI3_HOST"
			help
				USE SPI3_HOST. This is also called VSPI_HOST
	endchoice

	config CC1101_CHANNEL
		int "CC1101 channel"
		range 0 255
		default 0
		help
			Both receiver and transmitter must operate on the same channel

	choice
		prompt "CC1101 Frequency"
		default CC1101_FREQ_433
		help
			Select ISM band frequency

		config CC1101_FREQ_315
			bool "315 MHz" 
		config CC1101_FREQ_433
			bool "433 MHz" 
		config CC1101_FREQ_868
			bool "868 MHz" 
		config CC1101_FREQ_915
			bool "915 MHz" 
	endchoice

	choice
		prompt "CC1101 Modulation speed"
		default CC1101_SPEED_38400
		help
			Select Modulation speed.

		config CC1101_SPEED_4800
			bool "4.8 kbit/sec"
		config CC1101_SPEED_9600
			bool "9.6 kbit/sec"
		config CC1101_SPEED_19200
			bool "19.2 kbit/sec"    
		config CC1101_SPEED_38400
			bool "38.4 kbit/sec" 
	endchoice

	choice
		prompt "CC1101 TX power level"
		default CC1101_POWER_DEFAULT
		help
			Select TX power level.

		config CC1101_POWER_DEFAULT
			bool "Default power level"
		config CC1101_POWER_MIN
			bool "Minimum power level"
		config CC1101_POWER_0db
			bool "Power level is 0dBm"    
		config CC1101_POWER_MAX
			bool "Maximum power level" 
	endchoice

endmenu
```

## main/Kconfig.projbuild
```kconfig
menu "Application Configuration"

	choice DIRECTION
		prompt "Communication direction"
		default Receiver
		help
			Select Communication direction.
		config RECEIVER
			bool "Receiver"
			help
				Execute Receiver.
		config TRANSMITTER
			bool "Transmitter"
			help
				Execute Transmitter.
	endchoice

  config RECEIVER_ADDRESS
		depends on TRANSMITTER
    int "Receiver address"
    range 0 254
    default 0
    help
      Both receiver and transmitter must have the same address.

endmenu 
```

## nimble/main/Kconfig.projbuild
```kconfig
menu "Application Configuration"

	choice DIRECTION
		prompt "Communication polarity"
		default SENDER
		help
			Select Communication polarity.
		config SENDER
			bool "BLE to Radio"
			help
				BLE to Radio.
		config RECEIVER
			bool "Radio to BLE"
			help
				Radio to BLE.
	endchoice

endmenu 
```

## tusb-serial/main/Kconfig.projbuild
```kconfig
menu "Application Configuration"

	choice DIRECTION
		prompt "Communication polarity"
		default SENDER
		help
			Select Communication polarity.
		config SENDER
			bool "USB to Radio"
			help
				USB to Radio.
		config RECEIVER
			bool "Radio to USB"
			help
				Radio to USB.
	endchoice

endmenu 
```

## web-form/main/Kconfig.projbuild
```kconfig
menu "Application Configuration"

	menu "WiFi Setting"

		config ESP_WIFI_SSID
			string "WiFi SSID"
			default "myssid"
			help
				SSID (network name) for the example to connect to.

		config ESP_WIFI_PASSWORD
			string "WiFi Password"
			default "mypassword"
			help
				WiFi password (WPA or WPA2) for the example to use.

		config ESP_MAXIMUM_RETRY
			int "Maximum retry"
			default 5
			help
				Set the Maximum retry to avoid station reconnecting to the AP unlimited when the AP is really inexistent.

		config MDNS_HOSTNAME
			string "mDNS Hostname"
			default "esp32-server"
			help
				The mDNS host name used by the ESP32.

	endmenu

	menu "Radio Setting"

		choice DIRECTION
			prompt "Communication polarity"
			default SENDER
			help
				Select Communication polarity.
			config SENDER
				bool "WEB to Radio"
				help
					WEB to Radio.
			config RECEIVER
				bool "Radio to WEB"
				help
					Radio to WEB.
		endchoice

	endmenu

endmenu 
```
